## conf/layer.conf
```bitbake
# We have a conf and classes directory, add to BBPATH
BBPATH .= ":${LAYERDIR}"

# We have recipes-* directories, add to BBFILES
BBFILES += "${LAYERDIR}/recipes-*/*/*.bb \
            ${LAYERDIR}/recipes-*/*/*.bbappend"

BBFILE_COLLECTIONS += "meta-stm32mp135d-odyssey"
BBFILE_PATTERN_meta-stm32mp135d-odyssey = "^${LAYERDIR}/"
BBFILE_PRIORITY_meta-stm32mp135d-odyssey = "6"

LAYERDEPENDS_meta-iris = "core"
LAYERSERIES_COMPAT_meta-iris = "mickledore"

# Add device tree file to support ODYSSEY-NPi som
STM32MP_DT_FILES_ODYSSEY_NPI += "stm32mp135d-odyssey"
STM32MP_DEVICETREE:append = " ${STM32MP_DT_FILES_ODYSSEY_NPI} "


UBOOT_EXTLINUX_TARGETS_EXTRA_CONFIG_target-sdcard += "${STM32MP_DT_FILES_ODYSSEY_NPI}"
DEVICE_BOARD_ENABLE:SDCARD += "${@bb.utils.contains('BOOTDEVICE_LABELS', 'sdcard', '${STM32MP_DT_FILES_ODYSSEY_NPI}', '', d)}"

IMAGE_INSTALL:remove = "packagegroup-optee-test"
```
